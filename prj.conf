## CMakeLists.txt
```
# SPDX-License-Identifier: Apache-2.0

cmake_minimum_required(VERSION 3.13.1)
include($ENV{ZEPHYR_BASE}/cmake/app/boilerplate.cmake NO_POLICY_SCOPE)
project(peripheral)

target_sources(app PRIVATE
  src/DS3231.c
  src/lcs.c
  src/cts.c
  src/als.c
  src/main.c
)

set(CMAKE_EXPORT_COMPILE_COMMANDS ON) 
```

## prj.conf
```kconfig
# Incresed stack due to settings API usage
CONFIG_SYSTEM_WORKQUEUE_STACK_SIZE=2048

CONFIG_BT=y
CONFIG_BT_DEBUG_LOG=y
CONFIG_BT_SMP=y
CONFIG_BT_SIGNING=y
CONFIG_BT_PERIPHERAL=y
CONFIG_BT_GATT_DIS=y
CONFIG_BT_ATT_PREPARE_COUNT=5
CONFIG_BT_PRIVACY=y
CONFIG_BT_DEVICE_NAME="BT remote"
CONFIG_BT_DEVICE_APPEARANCE=833
CONFIG_BT_DEVICE_NAME_DYNAMIC=y
CONFIG_BT_DEVICE_NAME_MAX=65

CONFIG_BT_KEYS_OVERWRITE_OLDEST=y
CONFIG_BT_SETTINGS=y
CONFIG_FLASH=y
CONFIG_FLASH_PAGE_LAYOUT=y
CONFIG_FLASH_MAP=y
CONFIG_NVS=y
CONFIG_SETTINGS=y

CONFIG_RTT_CONSOLE=y
CONFIG_HAS_SEGGER_RTT=y
CONFIG_USE_SEGGER_RTT=y

CONFIG_PWM=y
CONFIG_PWM_NRFX=y
CONFIG_PWM_0=y

CONFIG_I2C=y
```

## src/main.c
```c
/* main.c - Application main entry point */

/*
 * Copyright (c) 2015-2016 Intel Corporation
 *
 * SPDX-License-Identifier: Apache-2.0
 */

#include <zephyr/types.h>
#include <stddef.h>
#include <string.h>
#include <errno.h>
#include <sys/printk.h>
#include <sys/byteorder.h>
#include <zephyr.h>

#include <settings/settings.h>

#include <bluetooth/bluetooth.h>
#include <bluetooth/hci.h>
#include <bluetooth/conn.h>
#include <bluetooth/uuid.h>
#include <bluetooth/gatt.h>

#include "als.h"	// Alarm service
#include "cts.h"	// Current time service
#include "lcs.h"	// Light control service

#define MAX_DATA 74

static const struct bt_data ad[] = {
	BT_DATA_BYTES(BT_DATA_FLAGS, (BT_LE_AD_GENERAL | BT_LE_AD_NO_BREDR)),
	BT_DATA_BYTES(BT_DATA_UUID16_ALL,
		      0x0d, 0x18, 0x0f, 0x18, 0x05, 0x18),
	BT_DATA_BYTES(BT_DATA_UUID128_ALL,
		      0xf0, 0xde, 0xbc, 0x9a, 0x78, 0x56, 0x34, 0x12,
		      0x78, 0x56, 0x34, 0x12, 0x78, 0x56, 0x34, 0x12),
};

static void connected(struct bt_conn *conn, u8_t err)
{
	if (err) {
		printk("Connection failed (err 0x%02x)\n", err);
	} else {
		printk("Connected\n");
	}
}

static void disconnected(struct bt_conn *conn, u8_t reason)
{
	printk("Disconnected (reason 0x%02x)\n", reason);
}

static struct bt_conn_cb conn_callbacks = {
	.connected = connected,
	.disconnected = disconnected,
};

static void bt_ready(void)
{
	int err;

	printk("Bluetooth initialized\n");

	if (IS_ENABLED(CONFIG_SETTINGS)) {
		settings_load();
	}

	err = bt_le_adv_start(BT_LE_ADV_CONN_NAME, ad, ARRAY_SIZE(ad), NULL, 0);
	if (err) {
		printk("Advertising failed to start (err %d)\n", err);
		return;
	}

	printk("Advertising successfully started\n");
}

static void auth_passkey_display(struct bt_conn *conn, unsigned int passkey)
{
	char addr[BT_ADDR_LE_STR_LEN];

	bt_addr_le_to_str(bt_conn_get_dst(conn), addr, sizeof(addr));

	printk("Passkey for %s: %06u\n", addr, passkey);
}

static void auth_cancel(struct bt_conn *conn)
{
	char addr[BT_ADDR_LE_STR_LEN];

	bt_addr_le_to_str(bt_conn_get_dst(conn), addr, sizeof(addr));

	printk("Pairing cancelled: %s\n", addr);
}

static struct bt_conn_auth_cb auth_cb_display = {
	.passkey_display = auth_passkey_display,
	.passkey_entry = NULL,
	.cancel = auth_cancel,
};

void main(void)
{
	int err = bt_enable(NULL);
	if (err) {
		printk("Bluetooth init failed (err %d)\n", err);
		return;
	}

	ds_init();
	cts_init();
	als_init();

	bt_ready();

	bt_conn_cb_register(&conn_callbacks);
	bt_conn_auth_cb_register(&auth_cb_display);

	bt_set_name("BT remote");

	while (1) {
		k_sleep(MSEC_PER_SEC);

		cts_print_ct();

		/*Notify on dim/pow value change and update pwm*/
		lcs_dim_notify();
		lcs_pow_notify();

		/* Notify on time change */
		cts_notify();
	}
}
```

## src/DS3231.c
```c
#include <zephyr/types.h>
#include <stddef.h>
#include <errno.h>
#include <sys/printk.h>
#include <sys/byteorder.h>
#include <zephyr.h>

#include <drivers/i2c.h>
#include <device.h>

#include "DS3231.h"

#define I2C_DEV "I2C_0"
#define DS3231_I2C_ADDR	0x68

struct device *i2c_dev;

void ds_init(void) {
	i2c_dev = device_get_binding(I2C_DEV);
	if (!i2c_dev) {
		printk("I2C: Device driver %s not found.\n", I2C_DEV);
	}
}

void ds_write_time(u8_t ct_in[], u8_t ct_len) {
	int err = i2c_burst_write(i2c_dev, DS3231_I2C_ADDR, REG_SECONDS, ct_in, ct_len);
	if (err) {
		printk("Failed to burst write by i2c, err: %d", err);
	}
}

void ds_read_time(u8_t ct_out[], u8_t ct_len) {
	u8_t start_reg[1] = {REG_SECONDS};
	u8_t tmp_reg[1] = {0};
	int err = i2c_write_read(i2c_dev, DS3231_I2C_ADDR, start_reg, 1, tmp_reg, 1);
	if (err) {
		printk("Failed to read by i2c, err: %d", err);
	}
}

void ds_modify_reg(u8_t reg_addr, u8_t mask, u8_t value) {
	int err = i2c_reg_update_byte(i2c_dev, DS3231_I2C_ADDR, reg_addr,
						mask, value);
	if (err) {
		printk("Failed to modify bit by i2c, err: %d", err);
	}
}
```

## src/DS3231.h
```c
#ifndef DS3231_RTC_H
#define DS3231_RTC_H

#include <zephyr/types.h>

#define REG_SECONDS			0x00
#define REG_MINUTES 		0x01
#define REG_HOURS			0x02
#define REG_DAY				0x03
#define REG_DATE			0x04
#define REG_MONTH			0x05
#define REG_YEAR 			0x06
#define REG_AL1_SECS 		0x07
#define REG_AL1_MINS 		0x08
#define REG_AL1_HRS 		0x09
#define REG_AL1_DAY_DATE	0x0A
#define REG_AL2_MINS 		0x0B
#define REG_AL2_HRS 		0x0C
#define REG_AL2_DAY_DATE 	0x0D
#define REG_CONTROL 		0x0E
#define REG_STATUS 			0x0F
#define REG_AG_OFFS 		0x10
#define REG_TEMP_MSB 		0x11
#define REG_TEMP_LSB 		0x12

void ds_init(void);

void ds_write_time(u8_t ct_in[], u8_t ct_len);

void ds_read_time(u8_t ct_out[], u8_t ct_len);

void ds_modify_reg(u8_t reg_addr, u8_t mask, u8_t value);

#endif
```

## src/als.c
```c
#include <zephyr/types.h>
#include <stddef.h>
#include <string.h>
#include <errno.h>
#include <sys/printk.h>
#include <sys/byteorder.h>
#include <zephyr.h>

#include <bluetooth/bluetooth.h>
#include <bluetooth/hci.h>
#include <bluetooth/conn.h>
#include <bluetooth/uuid.h>
#include <bluetooth/gatt.h>

#include "DS3231.h"
#include "als.h"

/* Custom Service Variables */
static struct bt_uuid_128 als_uuid = BT_UUID_INIT_128(
	0x14, 0x54, 0xd7, 0x54, 0xff, 0xec, 0x4c, 0x07,
	0x88, 0x85, 0x78, 0x41, 0x00, 0x30, 0xf1, 0x01);

static struct bt_uuid_128 als_al1_en_uuid = BT_UUID_INIT_128(
	0x14, 0x54, 0xd7, 0x54, 0xff, 0xec, 0x4c, 0x07,
	0x88, 0x85, 0x78, 0x41, 0x01, 0x30, 0xf1, 0x01);

static struct bt_uuid_128 als_al1_time_uuid = BT_UUID_INIT_128(
	0x14, 0x54, 0xd7, 0x54, 0xff, 0xec, 0x4c, 0x07,
	0x88, 0x85, 0x78, 0x41, 0x03, 0x30, 0xf1, 0x01);

static struct bt_uuid_128 als_al2_en_uuid = BT_UUID_INIT_128(
	0x14, 0x54, 0xd7, 0x54, 0xff, 0xec, 0x4c, 0x07,
	0x88, 0x85, 0x78, 0x41, 0x05, 0x30, 0xf1, 0x01);

static struct bt_uuid_128 als_al2_time_uuid = BT_UUID_INIT_128(
	0x14, 0x54, 0xd7, 0x54, 0xff, 0xec, 0x4c, 0x07,
	0x88, 0x85, 0x78, 0x41, 0x07, 0x30, 0xf1, 0x01);

static u8_t als_al1_en_value = 0;
static u8_t als_al1_time_value[3] = {0x00, 0x00, 0x00};
static u8_t als_al2_en_value = 0;
static u8_t als_al2_time_value[3] = {0x00, 0x00, 0x00};

static u8_t als_al1_en_cud[] = {'A', 'l', 'a', 'r', 'm', ' ', '1', ':', ' ',
								'E', 'n', 'a', 'b', 'l', 'e', '\0'};
static u8_t als_al1_time_cud[] = {'A', 'l', 'a', 'r', 'm', ' ', '1', ':', ' ',
								'T', 'i', 'm', 'e', '\0'};
static u8_t als_al2_en_cud[] = {'A', 'l', 'a', 'r', 'm', ' ', '2', ':', ' ',
								'E', 'n', 'a', 'b', 'l', 'e', '\0'};
static u8_t als_al2_time_cud[] = {'A', 'l', 'a', 'r', 'm', ' ', '2', ':', ' ',
								'T', 'i', 'm', 'e', '\0'};

static ssize_t read_als_al1_en(struct bt_conn *conn, const struct bt_gatt_attr *attr,
			   void *buf, u16_t len, u16_t offset)
{
	const char *value = attr->user_data;

	return bt_gatt_attr_read(conn, attr, buf, len, offset, value,
				 sizeof(als_al1_en_value));
}

static ssize_t write_als_al1_en(struct bt_conn *conn, const struct bt_gatt_attr *attr,
			    const void *buf, u16_t len, u16_t offset,
			    u8_t flags)
{
	u8_t *value = attr->user_data;

	if (offset + len > sizeof(als_al1_en_value)) {
		return BT_GATT_ERR(BT_ATT_ERR_INVALID_OFFSET);
	}

	memcpy(value + offset, buf, len);

	return len;
}

static ssize_t read_als_al1_time(struct bt_conn *conn, const struct bt_gatt_attr *attr,
			   void *buf, u16_t len, u16_t offset)
{
	const char *value = attr->user_data;

	return bt_gatt_attr_read(conn, attr, buf, len, offset, value,
				 sizeof(als_al1_time_value));
}

static ssize_t write_als_al1_time(struct bt_conn *conn, const struct bt_gatt_attr *attr,
			    const void *buf, u16_t len, u16_t offset,
			    u8_t flags)
{
	u8_t *value = attr->user_data;

	if (offset + len > sizeof(als_al1_time_value)) {
		return BT_GATT_ERR(BT_ATT_ERR_INVALID_OFFSET);
	}

	memcpy(value + offset, buf, len);

	return len;
}

static ssize_t read_als_al2_en(struct bt_conn *conn, const struct bt_gatt_attr *attr,
			   void *buf, u16_t len, u16_t offset)
{
	const char *value = attr->user_data;

	return bt_gatt_attr_read(conn, attr, buf, len, offset, value,
				 sizeof(als_al2_en_value));
}

static ssize_t write_als_al2_en(struct bt_conn *conn, const struct bt_gatt_attr *attr,
			    const void *buf, u16_t len, u16_t offset,
			    u8_t flags)
{
	u8_t *value = attr->user_data;

	if (offset + len > sizeof(als_al2_en_value)) {
		return BT_GATT_ERR(BT_ATT_ERR_INVALID_OFFSET);
	}

	memcpy(value + offset, buf, len);

	return len;
}

static ssize_t read_als_al2_time(struct bt_conn *conn, const struct bt_gatt_attr *attr,
			   void *buf, u16_t len, u16_t offset)
{
	const char *value = attr->user_data;

	return bt_gatt_attr_read(conn, attr, buf, len, offset, value,
				 sizeof(als_al2_time_value));
}

static ssize_t write_als_al2_time(struct bt_conn *conn, const struct bt_gatt_attr *attr,
			    const void *buf, u16_t len, u16_t offset,
			    u8_t flags)
{
	u8_t *value = attr->user_data;

	if (offset + len > sizeof(als_al2_time_value)) {
		return BT_GATT_ERR(BT_ATT_ERR_INVALID_OFFSET);
	}

	memcpy(value + offset, buf, len);

	return len;
}

/* Vendor Primary Service Declaration */
BT_GATT_SERVICE_DEFINE(als_svc,
	BT_GATT_PRIMARY_SERVICE(&als_uuid),
	BT_GATT_CHARACTERISTIC(&als_al1_en_uuid.uuid, BT_GATT_CHRC_READ |
			       BT_GATT_CHRC_WRITE,
			       BT_GATT_PERM_READ | BT_GATT_PERM_WRITE,
			       read_als_al1_en, write_als_al1_en, &als_al1_en_value),
	BT_GATT_CUD(als_al1_en_cud, BT_GATT_PERM_READ),
	BT_GATT_CHARACTERISTIC(&als_al1_time_uuid.uuid, BT_GATT_CHRC_READ |
			       BT_GATT_CHRC_WRITE,
			       BT_GATT_PERM_READ | BT_GATT_PERM_WRITE,
			       read_als_al1_time, write_als_al1_time, &als_al1_time_value),
	BT_GATT_CUD(als_al1_time_cud, BT_GATT_PERM_READ),
	BT_GATT_CHARACTERISTIC(&als_al2_en_uuid.uuid, BT_GATT_CHRC_READ |
			       BT_GATT_CHRC_WRITE,
			       BT_GATT_PERM_READ | BT_GATT_PERM_WRITE,
			       read_als_al2_en, write_als_al2_en, &als_al2_en_value),
	BT_GATT_CUD(als_al2_en_cud, BT_GATT_PERM_READ),
	BT_GATT_CHARACTERISTIC(&als_al2_time_uuid.uuid, BT_GATT_CHRC_READ |
			       BT_GATT_CHRC_WRITE,
			       BT_GATT_PERM_READ | BT_GATT_PERM_WRITE,
			       read_als_al2_time, write_als_al2_time, &als_al2_time_value),
	BT_GATT_CUD(als_al2_time_cud, BT_GATT_PERM_READ),
);

void als_init(void) {
	/*Enable interrupt on alarm 1 and alarm 2*/
	ds_modify_reg(REG_CONTROL, 0x3, 0x3);

	//More initializations
}
```

## src/als.h
```c
#ifndef LCS_H
#define LCS_H

void als_init(void);

#endif
```

## src/cts.c
```c
#include <zephyr/types.h>
#include <stddef.h>
#include <string.h>
#include <errno.h>
#include <sys/printk.h>
#include <sys/byteorder.h>
#include <zephyr.h>

#include <bluetooth/bluetooth.h>
#include <bluetooth/hci.h>
#include <bluetooth/conn.h>
#include <bluetooth/uuid.h>
#include <bluetooth/gatt.h>

#include "cts.h"
#include "DS3231.h"

#define CT_LEN 7
static u8_t ct[CT_LEN] = {21, 05, 00, 07, 12, 01, 20};

static ssize_t read_ct(struct bt_conn *conn, const struct bt_gatt_attr *attr,
		       void *buf, u16_t len, u16_t offset)
{
	const char *value = attr->user_data;

	return bt_gatt_attr_read(conn, attr, buf, len, offset, value,
				 sizeof(ct));
}

void encode_time(u8_t sec, u8_t min, u8_t hour, u8_t day,
						u8_t date, u8_t month, u8_t year);

static ssize_t write_ct(struct bt_conn *conn, const struct bt_gatt_attr *attr,
			const void *buf, u16_t len, u16_t offset,
			u8_t flags)
{
	u8_t *value = attr->user_data;

	if (offset + len > sizeof(ct)) {
		return BT_GATT_ERR(BT_ATT_ERR_INVALID_OFFSET);
	}

	memcpy(value + offset, buf, len);

	encode_time(ct[2], ct[1], ct[0], ct[3], ct[4], ct[5], ct[6]);

	return len;
}

/* Current Time Service Declaration */
BT_GATT_SERVICE_DEFINE(cts_cvs,
	BT_GATT_PRIMARY_SERVICE(BT_UUID_CTS),
	BT_GATT_CHARACTERISTIC(BT_UUID_CTS_CURRENT_TIME, BT_GATT_CHRC_READ |
			       BT_GATT_CHRC_NOTIFY | BT_GATT_CHRC_WRITE,
			       BT_GATT_PERM_READ | BT_GATT_PERM_WRITE,
			       read_ct, write_ct, ct),
	BT_GATT_CCC(NULL, BT_GATT_PERM_READ | BT_GATT_PERM_WRITE),
);

void encode_time(u8_t sec, u8_t min, u8_t hour, u8_t day,
						u8_t date, u8_t month, u8_t year) {
	u8_t enc_ct[CT_LEN];

	enc_ct[0] = ((sec / 10) << 4) + (sec % 10);
	enc_ct[1] = ((min / 10) << 4) + (min % 10);
	enc_ct[2] = ((hour / 10) << 4) + (hour % 10);
	enc_ct[3] = day;
	enc_ct[4] = ((date / 10) << 4) + (date % 10);
	enc_ct[5] = ((month / 10) << 4) + (month % 10);
	enc_ct[5] |= ((year / 100) << 7) & 0x80;
	enc_ct[6] = ((year / 10) << 4) + (year % 10);

	ds_write_time(enc_ct, CT_LEN);
}

void decode_time(void) {
	ds_read_time(ct, CT_LEN);

	ct[0] = (((ct[0] >> 4) & 0x7) * 10) + (ct[0] & 0xf);	//Seconds
	ct[1] = (((ct[1] >> 4) & 0x7) * 10) + (ct[1] & 0xf);	//Minutes
	ct[2] = (((ct[2] >> 4) & 0x3) * 10) + (ct[2] & 0xf);	//Hours
	ct[3] = ct[3] & 0x7;									//Days
	ct[4] = (((ct[4] >> 4) & 0x3) * 10) + (ct[4] & 0xf);	//Date
	ct[5] = (((ct[5] >> 4) & 0x1) * 10) + (ct[5] & 0xf);	//Month
	ct[6] = (((ct[5] >> 7) & 0x1) * 100) + 					//Century
			(((ct[6] >> 4) & 0xf) * 10) + (ct[6] & 0xf);	//Year
	
	/*Swap sec and hour for clarity*/
	u8_t tmp = ct[0];
	ct[0] = ct[2];
	ct[2] = tmp;
}

void cts_print_ct(void) {
	decode_time();

	printk("Time: %d : %d : %d\tDay: %d\tDate: %d / %d / %d\n",
			ct[0], ct[1], ct[2], ct[3],
			ct[4], ct[5], ct[6]);
}

void cts_init(void)
{
	/*Configure DS device*/
	/*Set 24h clock*/
	ds_modify_reg(REG_HOURS, (1 << 6), 0);
	/*Set current time*/
	encode_time(ct[2], ct[1], ct[0], ct[3], ct[4], ct[5], ct[6]);
}

void cts_notify(void)
{	
	bt_gatt_notify(NULL, &cts_cvs.attrs[1], &ct, sizeof(ct));
}
```

## src/cts.h
```c
#ifndef CTS_H
#define CTS_H

void cts_init(void);

void cts_notify(void);

void cts_print_ct(void);

#endif
```

## src/lcs.c
```c
#include <zephyr/types.h>
#include <stddef.h>
#include <string.h>
#include <errno.h>
#include <sys/printk.h>
#include <sys/byteorder.h>
#include <zephyr.h>

#include <bluetooth/bluetooth.h>
#include <bluetooth/hci.h>
#include <bluetooth/conn.h>
#include <bluetooth/uuid.h>
#include <bluetooth/gatt.h>

#include <device.h>
#include <drivers/pwm.h>

#include "lcs.h"

/* get the defines from dt (based on alias 'pwm-led0') */
#define PWM_DRIVER	DT_ALIAS_PWM_LED0_PWMS_CONTROLLER
#define PWM_CHANNEL	DT_ALIAS_PWM_LED0_PWMS_CHANNEL

/* Servo specifications, in microseconds*/
#define MIN_PULSE	17.5 * USEC_PER_MSEC
#define MAX_PULSE	19.5 * USEC_PER_MSEC
#define PERIOD	20U * USEC_PER_MSEC

/* Custom Service Variables */
static struct bt_uuid_128 lcs_uuid = BT_UUID_INIT_128(
	0x36, 0xa4, 0x21, 0xa3, 0xa5, 0xd4, 0x4a, 0xdc,
    0x8e, 0x4a, 0xf6, 0x5d, 0x00, 0xf7, 0x3c, 0x67);

static struct bt_uuid_128 lcs_pow_uuid = BT_UUID_INIT_128(
	0x36, 0xa4, 0x21, 0xa3, 0xa5, 0xd4, 0x4a, 0xdc,
    0x8e, 0x4a, 0xf6, 0x5d, 0x01, 0xf7, 0x3c, 0x67);

static struct bt_uuid_128 lcs_dim_uuid = BT_UUID_INIT_128(
	0x36, 0xa4, 0x21, 0xa3, 0xa5, 0xd4, 0x4a, 0xdc,
    0x8e, 0x4a, 0xf6, 0x5d, 0x03, 0xf7, 0x3c, 0x67);

static u8_t lcs_pow_value_update = 0;
static u8_t lcs_dim_value_update = 0;

static u8_t lcs_pow_value = 0x00;
static u8_t lcs_dim_value = 0x00;

static u8_t lcs_pow_cud[] = {'P', 'o', 'w', 'e', 'r', '\0'};
static u8_t lcs_dim_cud[] = {'D', 'i', 'm', 'm', 'e', 'r', '\0'};

static ssize_t read_lcs_pow(struct bt_conn *conn, const struct bt_gatt_attr *attr,
			   void *buf, u16_t len, u16_t offset)
{
	const char *value = attr->user_data;

	return bt_gatt_attr_read(conn, attr, buf, len, offset, value,
				 sizeof(lcs_pow_value));
}

static ssize_t write_lcs_pow(struct bt_conn *conn, const struct bt_gatt_attr *attr,
			    const void *buf, u16_t len, u16_t offset,
			    u8_t flags)
{
	u8_t *value = attr->user_data;

	if (offset + len > sizeof(lcs_pow_value)) {
		return BT_GATT_ERR(BT_ATT_ERR_INVALID_OFFSET);
	}

	memcpy(value + offset, buf, len);

	lcs_pow_value_update = 1;

	return len;
}

static ssize_t read_lcs_dim(struct bt_conn *conn, const struct bt_gatt_attr *attr,
			   void *buf, u16_t len, u16_t offset)
{
	const char *value = attr->user_data;

	return bt_gatt_attr_read(conn, attr, buf, len, offset, value,
				 sizeof(lcs_dim_value));
}

static ssize_t write_lcs_dim(struct bt_conn *conn, const struct bt_gatt_attr *attr,
			    const void *buf, u16_t len, u16_t offset,
			    u8_t flags)
{
	u8_t *value = attr->user_data;

	if (offset + len > sizeof(lcs_dim_value)) {
		return BT_GATT_ERR(BT_ATT_ERR_INVALID_OFFSET);
	}

	lcs_dim_value_update = 1;

	memcpy(value + offset, buf, len);

	return len;
}

/* Vendor Primary Service Declaration */
BT_GATT_SERVICE_DEFINE(lcs_svc,
	BT_GATT_PRIMARY_SERVICE(&lcs_uuid),
	BT_GATT_CHARACTERISTIC(&lcs_pow_uuid.uuid, BT_GATT_CHRC_READ |
			       BT_GATT_CHRC_WRITE,
			       BT_GATT_PERM_READ | BT_GATT_PERM_WRITE,
			       read_lcs_pow, write_lcs_pow, &lcs_pow_value),
	BT_GATT_CCC(NULL, BT_GATT_PERM_READ | BT_GATT_PERM_WRITE),
	BT_GATT_CUD(lcs_pow_cud, BT_GATT_PERM_READ),
	BT_GATT_CHARACTERISTIC(&lcs_dim_uuid.uuid, BT_GATT_CHRC_READ |
			       BT_GATT_CHRC_WRITE,
			       BT_GATT_PERM_READ | BT_GATT_PERM_WRITE,
			       read_lcs_dim, write_lcs_dim, &lcs_dim_value),
	BT_GATT_CCC(NULL, BT_GATT_PERM_READ | BT_GATT_PERM_WRITE),
	BT_GATT_CUD(lcs_dim_cud, BT_GATT_PERM_READ),
);

u32_t angle_to_pulse(u8_t angle) {
	u32_t pulse = 17500U + 11U * angle;
	if (pulse < MIN_PULSE) pulse = MIN_PULSE;
	if (pulse > MAX_PULSE) pulse = MAX_PULSE;
	return pulse;
}

void lcs_set_dim(u8_t dim_angle) {
	struct device *pwm_dev;
	u32_t period = PERIOD;

	pwm_dev = device_get_binding(PWM_DRIVER);
	if (!pwm_dev) {
		printk("Cannot find %s!\n", PWM_DRIVER);
		return;
	}

	int err = pwm_pin_set_usec(pwm_dev, PWM_CHANNEL, period, angle_to_pulse(lcs_dim_value));
	if (err) {
		printk("pwm pin set fails, err: %d\n", err);
		return;
	}
}

void lcs_pow_notify(void) {
    if (!lcs_pow_value_update) {
        return;
    }

    lcs_pow_value_update = 0;

    bt_gatt_notify(NULL, &lcs_svc.attrs[1], &lcs_pow_value, sizeof(lcs_pow_value));
}

void lcs_dim_notify(void) {
    if (!lcs_dim_value_update) {
        return;
    }

    lcs_dim_value_update = 0;

	lcs_set_dim(lcs_dim_value);

    bt_gatt_notify(NULL, &lcs_svc.attrs[4], &lcs_dim_value, sizeof(lcs_dim_value));
}
```

## src/lcs.h
```c
#ifndef LCS_H
#define LCS_H

void lcs_set_dim(u8_t dim_angle);

void lcs_pow_notify(void);

void lcs_dim_notify(void);

#endif
```
